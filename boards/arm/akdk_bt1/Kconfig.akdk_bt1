## boards/arm/akdk_bt1/Kconfig.akdk_bt1
```kconfig
# SPDX-License-Identifier: MIT

config BOARD_AKDK_BT1
	select SOC_NRF52840_QIAA if BOARD_AKDK_BT1_NRF52840
```

## boards/arm/akdk_bt1/board.yml
```yaml
board:
  name: akdk_bt1
  full_name: AKDK_BT1
  vendor: others
  socs:
    - name: nrf52840
```
