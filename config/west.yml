## config/west.yml
```yaml
manifest:
  remotes:
    - name: zmkfirmware
      url-base: https://github.com/zmkfirmware
    - name: sekigon-gonnoc
      url-base: https://github.com/sekigon-gonnoc
    # - name: halfdane # ★ 追加: zmk-input-gestures 用のリモート
    #   url-base: https://github.com/halfdane
  projects:
    - name: zmk
      remote: zmkfirmware
      revision: main
      import: app/west.yml
    - name: zmk-driver-paw3222
      remote: sekigon-gonnoc
      revision: main
    - name: zmk-driver-iqs7211e
      remote: sekigon-gonnoc
    # - name: zmk-input-gestures # ★ 追加: ジェスチャーモジュール
    #   remote: halfdane
    #   revision: main
  self:
    path: config
```
